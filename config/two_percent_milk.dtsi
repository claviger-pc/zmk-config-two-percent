/ {
    keymap_layout: keymap_layout {
        compatible = "zmk,physical-layout";
        display-name = "Default Layout";
        
        keys = <
            &key_physical_attrs 0 0 0 0 0 0 0
            &key_physical_attrs 0 100 0 0 0 0 0
        >;
    };
};
